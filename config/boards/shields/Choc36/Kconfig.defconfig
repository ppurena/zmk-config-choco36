## config/boards/shields/Choc36/Kconfig.defconfig
```kconfig
if SHIELD_CHOC36_LEFT

config ZMK_KEYBOARD_NAME
    default "Choc36"

config ZMK_SPLIT_BLE_ROLE_CENTRAL
    default y

endif

if SHIELD_CHOC36_LEFT || SHIELD_CHOC36_RIGHT

config ZMK_SPLIT
    default y

endif
```

## config/boards/shields/Choc36/Kconfig.shield
```kconfig
config SHIELD_CHOC36_LEFT
    def_bool $(shields_list_contains, Choc36_left)

config SHIELD_CHOC36_RIGHT
    def_bool $(shields_list_contains, Choc36_right)
```
